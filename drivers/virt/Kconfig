## drivers/virt/Kconfig
```kconfig
# SPDX-License-Identifier: GPL-2.0-only
#
# Virtualization support drivers
#

menuconfig VIRT_DRIVERS
	bool "Virtualization drivers"
	help
	  Say Y here to get to see options for device drivers that support
	  virtualization environments.

	  If you say N, all options in this submenu will be skipped and disabled.

if VIRT_DRIVERS

config VBS_SECURE_MONITOR
	bool "KVM VM-planes secure-plane monitor"
	depends on X86 && KVM_GUEST
	help
	  In-kernel monitor for the secure plane (plane >0) of a KVM VM-planes
	  guest.  When enabled and the "secure_monitor" kernel command-line
	  option is present, a kernel thread hands control back to the normal
	  plane via the KVM_HC_VBS_VTL_RETURN hypercall and then services VTL
	  calls from a shared calling area.

	  This is independent of the full VBS stack (CONFIG_VBS) so that any
	  secure kernel can act as plane 1.  Per-call handlers are plumbed in
	  incrementally; until then calls are acknowledged as no-ops.  Say N
	  unless this kernel is used as a VM-planes secure plane.

config VMGENID
	tristate "Virtual Machine Generation ID driver"
	default y
	help
	  Say Y here to use the hypervisor-provided Virtual Machine Generation ID
	  to reseed the RNG when the VM is cloned. This is highly recommended if
	  you intend to do any rollback / cloning / snapshotting of VMs.

	  Prefer Y to M so that this protection is activated very early.

config FSL_HV_MANAGER
	tristate "Freescale hypervisor management driver"
	depends on FSL_SOC
	select EPAPR_PARAVIRT
	help
          The Freescale hypervisor management driver provides several services
	  to drivers and applications related to the Freescale hypervisor:

          1) An ioctl interface for querying and managing partitions.

          2) A file interface to reading incoming doorbells.

          3) An interrupt handler for shutting down the partition upon
	     receiving the shutdown doorbell from a manager partition.

          4) A kernel interface for receiving callbacks when a managed
	     partition shuts down.

config STEAL_GOVERNOR
	tristate "Dynamic vCPU management based on steal time"
	depends on PARAVIRT && SMP
	select PREFERRED_CPU
	default m
	help
	  This driver helps to reduce the steal time in paravirtualized
	  environments, thereby reducing vCPU preemption costs.

	  By default preferred CPUs will be same as active CPUs. Depending
	  on the steal time when steal_governor driver is enabled,
	  preferred CPUs could become subset of active CPUs.
	  More details are at: Documentation/driver-api/steal-governor.rst

	  It is recommended to build it as module and load the module
	  to enable it.

source "drivers/virt/vboxguest/Kconfig"

source "drivers/virt/nitro_enclaves/Kconfig"

source "drivers/virt/acrn/Kconfig"

endif

source "drivers/virt/coco/Kconfig"
```

## security/vbs/Kconfig
```kconfig
# SPDX-License-Identifier: GPL-2.0-only

config VBS
	bool "Virtualization-Based Security (VBS) support"
	depends on X86_64
	help
	  Enable a transport-agnostic interface between the guest OS
	  (plane-0) and a secure kernel running in a higher-privileged
	  plane-1.

	  The core VBS layer dispatches calls from kernel subsystems to a
	  platform-specific backend.  VBS is software-only: backends are
	  software/hypervisor planes (KVM software planes now, Hyper-V VSM
	  later).  Hardware confidential-compute is out of scope.

	  If unsure, say N.

config VBS_KVM_PLANES
	bool "VBS backend: KVM software planes"
	depends on VBS && KVM_GUEST
	help
	  VBS backend that uses a KVM paravirt hypercall to communicate
	  between plane-0 (the normal guest kernel) and plane-1 (a secure
	  kernel running in a separate KVM VM plane managed by QEMU).

	  This minimal backend supports loading (connecting to) and
	  unloading the secure plane via a shared-memory calling area.

	  Select this if you are running under KVM with VM planes support.

	  If unsure, say N.
```
